## config/boards/shields/karma/Kconfig.shield
```kconfig
config SHIELD_KARMA_LEFT
    def_bool $(shields_list_contains,karma_left)

config SHIELD_KARMA_RIGHT
    def_bool $(shields_list_contains,karma_right)

config SHIELD_KARMA_DONGLE
    def_bool $(shields_list_contains,karma_dongle)
```
